## libs/ai_aton/Kconfig
```kconfig
config LIB_AI_ATON
	bool "ST Neural-ART (ATON) NN runtime"
	default n
	depends on ARCH_CHIP_STM32N6
	---help---
		Build the vendored ST Neural-ART (ATON) neural-network runtime
		(ll_aton + NetworkRuntime) for the STM32N6 NPU.

		This adds:
		  - the ST public AI headers (Inc/) and the ll_aton headers
		  - the prebuilt NetworkRuntime1000_CM55_GCC.a, which provides
		    stai_runtime_init/deinit/get_info and the ai_* layer plus
		    CMSIS-NN operators
		  - the NuttX OSAL implementation required by the middleware
		    (libs/ai_aton/ll_aton_osal_nuttx.c)

		The middleware selects a custom OSAL through
		LL_ATON_OSAL=LL_ATON_OSAL_USER_IMPL, which makes its
		ll_aton_osal.h include ll_aton_osal_user_impl.h from this
		directory.

		The AI Engine lower-half driver (arch/arm/src/stm32n6/
		stm32n6_aton_aie.c) uses this runtime when it is enabled.

if LIB_AI_ATON

choice
	prompt "ATON network model"
	default AI_ATON_MODEL_NONE
	---help---
		Select the ATON-compiled network to link into the firmware.  A
		model is required to run an inference (LL_ATON_RT_Main): it
		provides the epoch blocks, the tensor pool layout and the user
		input/output tensor buffers.

		The models under models/ are generated by ST Edge AI Core for
		the STM32N6 NPU; the directory holds the generated network.c and
		its epoch-controller blobs.

config AI_ATON_MODEL_NONE
	bool "no model (hardware bring-up only)"

config AI_ATON_MODEL_POSE994
	bool "pose994: yolov8n-pose 256x256 (ST 994_AI_Multi_Pose_Estimation)"
	---help---
		Multi-pose estimation model shipped with the ST application
		example Projects/99_Applications/994_AI_Multi_Pose_Estimation.

		This model expects its tensor pool at 0x34200000 (AXISRAM3..6,
		1.75MB window, ~905KB used) and its initializers (weights) in the
		external flash at 0x70200000 - the flash region has to be
		programmed from the example's Binary/network-data.hex.

		Therefore the CPU RAM window must end at 0x34200000 when this
		model is used (see the board's "npu" configuration).

config AI_ATON_MODEL_PALM995
	bool "palm995: palm detection 192x192 (ST 995_AI_Hand_Landmarks)"
	---help---
		Palm detector shipped with the ST application example
		Projects/99_Applications/995_AI_Hand_Landmarks (the first stage of
		its hand pipeline; the 224x224 landmark network is a separate
		model and is not part of this build).

		Same memory contract as pose994: tensor pool at 0x34200000 and
		initializers in the external flash at 0x70200000, programmed from
		the example's Binary/network-data.hex (about 4.5MB, so the
		non-secure NOR window reaches 0x70734FFF).

config AI_ATON_MODEL_EYE
	bool "eye: blink 64x128 int8 (openvela eye controller)"
	---help---
		Eye blink (open / closed) classifier for the openvela eye
		controller.  Trained on captured eye-ROI frames with MobileNetV2
		and quantized to QDQ int8 with ONNX Runtime (weights 8.43 MiB
		float32 -> 2.30 MiB int8, 53 epochs all running on the NPU).
		Generated with ST Edge AI Core using --c-api legacy, so it links
		against the vendored NetworkRuntime1000_CM55_GCC.a of this tree.

		Memory contract: tensor pool in AXISRAM3..6 at 0x34200000
		(activations ~240KB, placed in npuRAM5 @0x342E0000), initializers
		in the external flash at 0x70400000 (2.31MB, programmed from
		eye-data.hex).  The CPU RAM window must still end at 0x34200000,
		exactly as for palm995/pose994.

endchoice

config AI_ATON_MODEL
	string
	default "pose994" if AI_ATON_MODEL_POSE994
	default "palm995" if AI_ATON_MODEL_PALM995
	default "eye" if AI_ATON_MODEL_EYE
	default "none"

endif # LIB_AI_ATON
```
