## app/examples/aie_probe/Kconfig
```kconfig
#
# For a description of the syntax of this configuration file,
# see the file kconfig-language.txt in the NuttX tools repository.
#

config EXAMPLES_AIE_PROBE
        tristate "Neural-ART NPU AI Engine probe (/dev/aie0)"
        default n
        depends on STM32N6_ATON_AIE
        ---help---
                AI Engine probe for the ALIENTEK STM32N647 board: opens
                /dev/aie0, loads an inference session and exercises the
                feed-input / get-output ioctls.  Verifies the full AI
                Engine registration chain (board_bringup ->
                stm32n6_aton_aie_initialize -> aie_register).

                Usage:  aie_probe

if EXAMPLES_AIE_PROBE

config EXAMPLES_AIE_PROBE_DEVPATH
        string "AI Engine device path"
        default "/dev/aie0"
        ---help---
                The AI Engine device node opened by the probe.

config EXAMPLES_AIE_PROBE_PROGNAME
        string "Program name"
        default "aie_probe"
        ---help---
                This is the name of the program that will be used when the
                NSH ELF program is installed.

config EXAMPLES_AIE_PROBE_PRIORITY
        int "AIE probe task priority"
        default 100

config EXAMPLES_AIE_PROBE_STACKSIZE
        int "AIE probe stack size"
        default DEFAULT_TASK_STACKSIZE

endif
```

## app/examples/cam/Kconfig
```kconfig
#
# For a description of the syntax of this configuration file,
# see the file kconfig-language.txt in the NuttX tools repository.
#

config EXAMPLES_CAM
	tristate "IMX335 camera live-view demo"
	default n
	depends on STM32_DCMIPP && STM32_IMX335 && VIDEO_FB
	---help---
		Live camera view demo for the ALIENTEK STM32N647 board: powers
		the IMX335 sensor, initializes the DCMIPP capture pipeline and
		streams 800x480 RGB565 frames directly into the LTDC
		framebuffer (/dev/fb0).  Usage:
		  cam start   - power sensor, init DCMIPP, start capture
		  cam stop    - stop capture
		  cam status  - show captured frame count

if EXAMPLES_CAM

config EXAMPLES_CAM_PROGNAME
	string "Program name"
	default "cam"
	---help---
		This is the name of the program that will be used when the NSH
		ELF program is installed.

config EXAMPLES_CAM_PRIORITY
	int "CAM task priority"
	default 100

config EXAMPLES_CAM_STACKSIZE
	int "CAM stack size"
	default DEFAULT_TASK_STACKSIZE

endif
```

## app/examples/cam_probe/Kconfig
```kconfig
#
# For a description of the syntax of this configuration file,
# see the file kconfig-language.txt in the NuttX tools repository.
#

config EXAMPLES_CAM_PROBE
        tristate "Camera hardware probe"
        default n
        ---help---
                Run the camera hardware probe on real silicon: verifies the
                DCMIPP clock gate and identification register, and the IMX335
                sensor answering on I2C2 (ID register 0x3912).  First step of
                the Phase 6 camera driver port.  Usage: cam_probe

if EXAMPLES_CAM_PROBE

config EXAMPLES_CAM_PROBE_PROGNAME
        string "Program name"
        default "cam_probe"
        ---help---
                This is the name of the program that will be used when the NSH ELF
                program is installed.

config EXAMPLES_CAM_PROBE_PRIORITY
        int "CAM probe task priority"
        default 100

config EXAMPLES_CAM_PROBE_STACKSIZE
        int "CAM probe stack size"
        default DEFAULT_TASK_STACKSIZE

endif
```

## app/examples/cam_save/Kconfig
```kconfig
#
# For a description of the syntax of this configuration file,
# see the file kconfig-language.txt in the NuttX tools repository.
#

config EXAMPLES_CAM_SAVE
        tristate "Camera frame capture to TF card (dataset)"
        default n
        depends on STM32N6_VIDEO
        ---help---
                Capture camera frames (800x480 RGB565) from /dev/video0,
                downscale to 96x96 grayscale and write BMP files to the
                TF card FATFS mount point.  Use it to collect training
                data on the real hardware.

                Usage:  cam_save [nsamples] [label]

if EXAMPLES_CAM_SAVE

config EXAMPLES_CAM_SAVE_MOUNTPOINT
        string "TF card mount point"
        default "/mnt/sdcard"
        ---help---
                The FATFS mountpoint (must match STM32N6_SDMMC_MOUNTPOINT).

config EXAMPLES_CAM_SAVE_PROGNAME
        string "Program name"
        default "cam_save"

config EXAMPLES_CAM_SAVE_PRIORITY
        int "cam_save task priority"
        default 100

config EXAMPLES_CAM_SAVE_STACKSIZE
        int "cam_save stack size"
        default DEFAULT_TASK_STACKSIZE

endif
```

## app/examples/eye_cam/Kconfig
```kconfig
#
# For a description of the syntax of this configuration file,
# see the file kconfig-language.txt in the NuttX tools repository.
#

config EXAMPLES_EYE_CAM
        tristate "Blink classifier on the NPU, annotated on the LCD"
        default n
        depends on STM32N6_VIDEO
        ---help---
                Runs the trained blink model continuously: the eye ROI is cut
                out of the camera frame, quantised to the model's int8 tensor
                and handed to the ATON NPU, and the verdict comes back as a
                coloured box on the panel.

                Everything on the path - the ROI rectangle (x=235 y=155
                300x145), the RGB565 expansion, the PIL-compatible bilinear
                resize, the planar NCHW byte order and the quantisation
                parameters - is taken from the training pipeline on purpose:
                each of them fails silently, so a mismatch shows up as an
                accuracy drop rather than as an error.  See the file header
                for the details.

                Usage:  eye_cam [iterations] [hold_ms]
                        (no iterations = run until Ctrl-C)

                        eye_cam capture <label> [count]
                        Writes the crop the classifier is given to
                        <mountpoint>/eye_ds as <label>_NNNN.bmp, one file
                        per frame, plus a meta.txt line carrying that
                        frame's crop and detection geometry.  Stops after
                        count frames (default 220) so every class is a
                        separate run and a batch can be redone on its own.

if EXAMPLES_EYE_CAM

config EXAMPLES_EYE_CAM_PROGNAME
        string "Program name"
        default "eye_cam"

config EXAMPLES_EYE_CAM_PRIORITY
        int "eye_cam task priority"
        default 100

config EXAMPLES_EYE_CAM_STACKSIZE
        int "eye_cam stack size"
        default 8192

endif
```

## app/examples/eye_guide/Kconfig
```kconfig
#
# For a description of the syntax of this configuration file,
# see the file kconfig-language.txt in the NuttX tools repository.
#

config EXAMPLES_EYE_GUIDE
	tristate "Eye-capture framing guide (ROI overlay on the LCD)"
	default n
	depends on STM32N6_VIDEO
	---help---
		Streams the camera and draws the eye ROI on top of it: a green box
		(x=235 y=155 300x145 in the 800x480 frame), four yellow corner ticks,
		a centre cross and a dashed line marking the eye height (+28 px
		inside the ROI).  Align both eyes inside the box and on that line
		before capturing a dataset.

		Why: training and inference must see the same framing, and the first
		capture round showed how fast that drifts -- the closed-eye batch
		ended up ~1.4x further from the camera than the open-eye batch,
		which teaches the classifier "face size" instead of "eyelid state".

		The camera writes the same buffer the LTDC scans out, so the guide is
		redrawn continuously and visibly flickers; lower the frame rate
		("imx335_tune fps 5") for a steadier box.

		Usage:  eye_guide [seconds]

if EXAMPLES_EYE_GUIDE

config EXAMPLES_EYE_GUIDE_PROGNAME
	string "Program name"
	default "eye_guide"

config EXAMPLES_EYE_GUIDE_PRIORITY
	int "eye_guide task priority"
	default 100

config EXAMPLES_EYE_GUIDE_STACKSIZE
	int "eye_guide stack size"
	default 4096

endif
```

## app/examples/fsbl_regress/Kconfig
```kconfig
#
# For a description of the syntax of this configuration file,
# see the file kconfig-language.txt in the NuttX tools repository.
#

config EXAMPLES_FSBL_REGRESS
        tristate "FSBL regression probe"
        default n
        ---help---
                Run the FSBL regression probe on real silicon: read-back of
                the RIF/LPENR configuration the custom FSBL programmed,
                DMA2D R2M writes into FLEXMEM and AXISRAM1/2, and a GPDMA1
                M2M copy.  Verifies the widened RISAF2/3 windows did not
                break the CID0 masters.  Usage: fsbl_regress

if EXAMPLES_FSBL_REGRESS

config EXAMPLES_FSBL_REGRESS_PROGNAME
        string "Program name"
        default "fsbl_regress"
        ---help---
                This is the name of the program that will be used when the NSH ELF
                program is installed.

config EXAMPLES_FSBL_REGRESS_PRIORITY
        int "FSBL regress task priority"
        default 100

config EXAMPLES_FSBL_REGRESS_STACKSIZE
        int "FSBL regress stack size"
        default DEFAULT_TASK_STACKSIZE

endif
```

## app/examples/palm_cam/Kconfig
```kconfig
#
# For a description of the syntax of this configuration file,
# see the file kconfig-language.txt in the NuttX tools repository.
#

config EXAMPLES_PALM_CAM
	tristate "Camera -> ATON NPU palm detection (ST 995)"
	default n
	depends on STM32N6_VIDEO
	---help---
		Capture a frame from /dev/video0 (IMX335 -> DCMIPP -> LTDC
		framebuffer), convert it to the model input (RGB888 256x256),
		run ST's 994 yolov8n-pose network on the ATON NPU and print the
		best palm detection (score, box, 7 palm landmarks).

		The NPU side is configured separately (CONFIG_LIB_AI_ATON with
		the pose994 model linked in).  A mounted TF card is optional:
		when the mount point is writable, the captured frame (PPM), the
		exact input tensor and the raw output tensor are written there
		for PC-side inspection.

		Usage:  palm_cam [runs]

if EXAMPLES_PALM_CAM

config EXAMPLES_PALM_CAM_OVERLAY
	bool "Draw the detection on the LCD"
	default y
	---help---
		Annotate the frozen camera frame on /dev/fb0: a green (palm) or red
		(no palm) band across the top, the confidence as digits and a bar,
		the decoded box and the seven keypoints.

		The stream is stopped as soon as a frame has been captured, because
		the DCMIPP writes the same buffer the LTDC scans out: anything drawn
		while the camera streams would be overwritten within one frame
		time.  Keeping the frame frozen is what makes the result readable
		on the panel instead of only on the serial console.

config EXAMPLES_PALM_CAM_LETTERBOX
	bool "Keep the camera aspect ratio (letterbox input)"
	default n
	---help---
		ST's reference application (Projects/99_Applications/
		995_AI_Hand_Landmarks) feeds the model a 192x115 picture with
		black rows underneath, and that is what this option reproduces
		from the 800x480 LTDC framebuffer.

		It is OFF by default because on this board it measurably costs
		detection margin: for the same frame the reference model scores
		logit +0.86 with the letterbox layout, +2.49 when the frame is
		stretched into 192x192 (and +1.95 with a centred square crop).
		The ATON NPU and the PC reference differ by up to ~3.5 logits on
		individual inputs, so a 0.86 margin is below that noise floor and
		the detection can flip sign (observed: palm clearly in view, board
		peak logit -2.59 -> "no palm").  With the stretch layout the same
		kind of frame was detected at logit +1.84 on the board.

		Enable it only to reproduce ST's layout for comparison.

config EXAMPLES_PALM_CAM_MOUNTPOINT
	string "TF card mount point"
	default "/mnt/sdcard"
	---help---
		Where the frame/tensor dumps are written.  Saving is skipped
		with a message when the path is not writable.

config EXAMPLES_PALM_CAM_PROGNAME
	string "Program name"
	default "palm_cam"

config EXAMPLES_PALM_CAM_PRIORITY
	int "palm_cam task priority"
	default 100

config EXAMPLES_PALM_CAM_STACKSIZE
	int "palm_cam stack size"
	default 8192

endif
```

## app/examples/pose_cam/Kconfig
```kconfig
#
# For a description of the syntax of this configuration file,
# see the file kconfig-language.txt in the NuttX tools repository.
#

config EXAMPLES_POSE_CAM
	tristate "Camera -> ATON NPU pose estimation (ST 994)"
	default n
	depends on STM32N6_VIDEO
	---help---
		Capture a frame from /dev/video0 (IMX335 -> DCMIPP -> LTDC
		framebuffer), convert it to the model input (RGB888 256x256),
		run ST's 994 yolov8n-pose network on the ATON NPU and print the
		17 COCO keypoints of the best detection.

		The NPU side is configured separately (CONFIG_LIB_AI_ATON with
		the pose994 model linked in).  A mounted TF card is optional:
		when the mount point is writable, the captured frame (PPM), the
		exact input tensor and the raw output tensor are written there
		for PC-side inspection.

		Usage:  pose_cam [runs]

if EXAMPLES_POSE_CAM

config EXAMPLES_POSE_CAM_MOUNTPOINT
	string "TF card mount point"
	default "/mnt/sdcard"
	---help---
		Where the frame/tensor dumps are written.  Saving is skipped
		with a message when the path is not writable.

config EXAMPLES_POSE_CAM_PROGNAME
	string "Program name"
	default "pose_cam"

config EXAMPLES_POSE_CAM_PRIORITY
	int "pose_cam task priority"
	default 100

config EXAMPLES_POSE_CAM_STACKSIZE
	int "pose_cam stack size"
	default 8192

endif
```

## app/examples/video/Kconfig
```kconfig
#
# For a description of the syntax of this configuration file,
# see the file kconfig-language.txt in the NuttX tools repository.
#

config EXAMPLES_VIDEO
        tristate "V4L2 camera capture test (/dev/video0)"
        default n
        depends on STM32N6_VIDEO
        ---help---
                V4L2 camera capture demo for the ALIENTEK STM32N647 board:
                opens /dev/video0, queries the device, sets 800x480 RGB565,
                streams and reads frames in zero-copy frame-sync mode
                (read(fd, NULL, 0) + direct access to the LTDC framebuffer).

                Usage:  video [nframes]

if EXAMPLES_VIDEO

config EXAMPLES_VIDEO_PROGNAME
        string "Program name"
        default "video"
        ---help---
                This is the name of the program that will be used when the NSH
                ELF program is installed.

config EXAMPLES_VIDEO_PRIORITY
        int "VIDEO task priority"
        default 100

config EXAMPLES_VIDEO_STACKSIZE
        int "VIDEO stack size"
        default DEFAULT_TASK_STACKSIZE

endif
```
